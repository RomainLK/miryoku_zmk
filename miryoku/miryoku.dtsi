// Copyright 2022 Manna Harbour
// https://github.com/manna-harbour/miryoku

#include <behaviors.dtsi>
#include <behaviors/mouse_key_press.dtsi>
#if defined (MIRYOKU_KLUDGE_MOUSEKEYSPR)
  #include <behaviors/mouse_move.dtsi>
  #include <behaviors/mouse_scroll.dtsi>
#endif
#include <dt-bindings/zmk/keys.h>

#define HOST_OS 2
#include "../zmk-nodefree-config/helper.h"
#include "../zmk-nodefree-config/international_chars/french_alt.dtsi"
#include "../zmk-nodefree-config/keypos_def/keypos_42keys.h"

#undef COMBO_TERM
#define COMBO_TERM 50
ZMK_COMBO(agrave,  &fr_a_grave, LT3 LT4, 0) 
ZMK_COMBO(ecute,  &fr_e_acute, LT2 LT3, 0) 
ZMK_COMBO(egrave,  &fr_e_grave, LT1 LT2, 0) 
ZMK_COMBO(ecirconflex,  &fr_e_circumflex, LT1 LT2 LT3,  0) 
 
ZMK_COMBO(ccedilla,  &fr_c_cedilla, LB1 LB2, 0) 

ZMK_COMBO(ugrave,  &fr_u_grave, RT1 RT2, 0) 
ZMK_COMBO(ucirconflex,  &fr_u_circumflex, RT0 RT1 RT2, 0) 

ZMK_COMBO(icirconflex,  &fr_i_circumflex, RT1 RT2  RT3, 0) 
ZMK_COMBO(idiaresis,  &fr_i_diaeresis, RT2  RT3, 0) 

ZMK_COMBO(ocircumflex,  &fr_o_circumflex, RT3 RT4, 0) 

ZMK_UNICODE_SINGLE(euro_sign, KP_N0, KP_N1, KP_N2, KP_N8)

// ZMK_COMBO(agrave,  &fr_a_grave, LT3, LT4, ALL) 
// ZMK_COMBO(agrave,  &fr_a_grave, LT3, LT4, ALL) 

#include "custom_behaviors.dtsi"

#include <dt-bindings/zmk/bt.h>
#include <dt-bindings/zmk/rgb.h>
#include <dt-bindings/zmk/outputs.h>
#include <dt-bindings/zmk/ext_power.h>

#include "miryoku.h"

#include <dt-bindings/zmk/mouse.h>

/ {
  keymap {
    compatible = "zmk,keymap";
#define MIRYOKU_X(LAYER, STRING) \
    LAYER { \
      label = STRING; \
      bindings = < U_MACRO_VA_ARGS(MIRYOKU_LAYERMAPPING_##LAYER, MIRYOKU_LAYER_##LAYER) >; \
    };
MIRYOKU_LAYER_LIST
#undef MIRYOKU_X
  };
};

#include "miryoku_shift_functions.dtsi"

#include "miryoku_double_tap_guard.dtsi"

#if defined (MIRYOKU_KLUDGE_MOUSEKEYSPR)
  #include "miryoku_kludge_mousekeyspr.dtsi"
#else
  #include "miryoku_mousekeys.dtsi"
#endif

#if defined (MIRYOKU_KLUDGE_THUMBCOMBOS)
  #include "miryoku_kludge_thumbcombos.dtsi"
#endif

#if defined (MIRYOKU_KLUDGE_TOPROWCOMBOS)
  #include "miryoku_kludge_toprowcombos.dtsi"
#endif

#if defined (MIRYOKU_KLUDGE_BOTTOMROWCOMBOS)
  #include "miryoku_kludge_bottomrowcombos.dtsi"
#endif

#if defined (MIRYOKU_KLUDGE_TAPDELAY)
  #include "miryoku_kludge_tapdelay.dtsi"
#else
  #include "miryoku_behaviors.dtsi"
#endif

#include "custom_macro.dtsi"
#include "custom_combo.dtsi"